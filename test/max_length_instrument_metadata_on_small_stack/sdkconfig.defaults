## test/max_length_instrument_metadata_on_small_stack/sdkconfig.defaults
```kconfig
CONFIG_IDF_TARGET="esp32s3"

CONFIG_FREERTOS_HZ=1000

CONFIG_SPIRAM=y
CONFIG_SPIRAM_SPEED_80M=y
CONFIG_SPIRAM_MODE_OCT=y

CONFIG_PARTITION_TABLE_SINGLE_APP_LARGE=y

CONFIG_ESP_MAIN_TASK_STACK_SIZE=16384

# The tests read metrics back through their own reader; no exporter is needed.
CONFIG_ESP_OPENTELEMETRY_EXPORTER_OTLP_HTTP=n
CONFIG_ESP_OPENTELEMETRY_EXPORTER_OSTREAM=n
CONFIG_ESP_OPENTELEMETRY_EXPORTER_ESP_LOG=n

CONFIG_ESP_OPENTELEMETRY_TRACING_ENABLED=n
CONFIG_ESP_OPENTELEMETRY_METRICS_ENABLED=y
CONFIG_ESP_OPENTELEMETRY_LOGS_ENABLED=n
CONFIG_ESP_OPENTELEMETRY_PROFILING_ENABLED=n
```
